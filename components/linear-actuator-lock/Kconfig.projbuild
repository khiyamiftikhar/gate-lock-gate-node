## components/linear-actuator-lock/Kconfig.projbuild
```kconfig
menu "Linear Lock Configuration"

    config MOTOR_DRIVER_D0
        int "MOTOR DRIVER D0"
        default 13
        help
            Select D0 pin of the motor driver

    config MOTOR_DRIVER_D1
        int "MOTOR DRIVER D1"
        default 27
        help
            Select D1 pin of the motor driver
endmenu
```
